## prj.conf
```kconfig
CONFIG_I2C=y
CONFIG_NRFX_TWIS=y
CONFIG_RTIO=y
CONFIG_I2C_RTIO=y
CONFIG_I2C_TARGET=y
CONFIG_I2C_TARGET_BUFFER_MODE=y

CONFIG_ZTEST=y

# CONFIG_LOG_DEFAULT_LEVEL=4
```

## src/main.c
```c
/*
 * Copyright (c) 2026 Nordic Semiconductor ASA
 *
 * SPDX-License-Identifier: LicenseRef-Nordic-5-Clause
 */

#include <zephyr/kernel.h>
#include <zephyr/drivers/i2c.h>
#include <zephyr/linker/devicetree_regions.h>
#include <zephyr/device.h>
#include <zephyr/drivers/pinctrl.h>
#include <zephyr/rtio/rtio.h>
#include <zephyr/drivers/i2c/rtio.h>
#include <nrfx_twis.h>
#include <zephyr/ztest.h>

#define NODE_TWIM	    DT_NODELABEL(dut_twim)
#define NODE_TWIS	    DT_NODELABEL(dut_twis)

#define TWIM_DEV_CONFIG        (I2C_SPEED_SET(I2C_SPEED_STANDARD) | I2C_MODE_CONTROLLER)

#define TWIS_MEMORY_SECTION                                                                        \
	COND_CODE_1(DT_NODE_HAS_PROP(NODE_TWIS, memory_regions),                                   \
		    (__attribute__((__section__(                                                   \
			    LINKER_DT_NODE_REGION_NAME(DT_PHANDLE(NODE_TWIS, memory_regions)))))), \
		    ())

#define I2C_DEVICE_ADDR 0x54
#define TEST_DATA_PATTEREN 0xAB
#define MAX_TEST_DATA_SIZE 5

/*
 * TWIM - RTIO driver
 * TWIS - standard TWIS driver 
 */

/*
* 3 submission queue events (SQEs); configuration, i2c write, i2c read
* 2 completion queue events (CQEs); i2c write result, i2c read result
*/
RTIO_DEFINE(twim_rtio_context, 2, 1);

I2C_IODEV_DEFINE(twim_rtio_io_dev, NODE_TWIM, I2C_DEVICE_ADDR);

static nrfx_twis_t twis = {
	.p_reg = (NRF_TWIS_Type *)DT_REG_ADDR(NODE_TWIS)
};

static uint8_t i2c_slave_buffer[MAX_TEST_DATA_SIZE] TWIS_MEMORY_SECTION;
static uint8_t i2c_master_buffer[MAX_TEST_DATA_SIZE];

struct i2c_api_twis_fixture {
	// const struct device *dev;
	uint8_t addr;
	uint8_t *const master_buffer;
	uint8_t *const slave_buffer;
};

static struct i2c_api_twis_fixture fixture = {
	// .dev = DEVICE_DT_GET(DT_BUS(NODE_TWIM)),
	.addr = I2C_DEVICE_ADDR,
	.master_buffer = i2c_master_buffer,
	.slave_buffer = i2c_slave_buffer,
};

static void i2s_slave_handler(nrfx_twis_event_t const *p_event)
{
	switch (p_event->type) {
	case NRFX_TWIS_EVT_READ_REQ:
		nrfx_twis_tx_prepare(&twis, i2c_slave_buffer, MAX_TEST_DATA_SIZE);
		break;
	case NRFX_TWIS_EVT_READ_DONE:
		break;
	case NRFX_TWIS_EVT_WRITE_REQ:
		nrfx_twis_rx_prepare(&twis, i2c_slave_buffer, MAX_TEST_DATA_SIZE);
		break;
	case NRFX_TWIS_EVT_WRITE_DONE:
		break;
	default:
		break;
	}
}

static void cleanup_buffers(void)
{
	memset(fixture.slave_buffer, 0xFF, MAX_TEST_DATA_SIZE);
	memset(fixture.master_buffer, 0xFF, MAX_TEST_DATA_SIZE);
}

static void prepare_test_data(uint8_t *const buffer, size_t buffer_size)
{
	for (size_t counter = 0; counter < buffer_size; counter++) {
		buffer[counter] = counter;
	}
}

static void show_buffers(void) {
    TC_PRINT("############################:\n");
    for (unsigned int i = 0; i < MAX_TEST_DATA_SIZE; i++) 
    {
        TC_PRINT("fixture.master_buffer[%u] = 0x%x\n", i, fixture.master_buffer[0]);
        TC_PRINT(" *** \n");
        TC_PRINT("fixture.slave_buffer[%u] = 0x%x\n", i, fixture.slave_buffer[0]);
        TC_PRINT(" *** \n");
    }
    TC_PRINT("############################:\n");
}

static void twim_rtio_configure(void)
{
    struct rtio_sqe *sqe;
	struct rtio_cqe *cqe;
	sqe = rtio_sqe_acquire(&twim_rtio_context);
	rtio_sqe_prep_i2c_configure(sqe,
				    &twim_rtio_io_dev,
				    0,
				    TWIM_DEV_CONFIG,
				    NULL);

	// sqe->flags |= RTIO_SQE_CHAINED;

	// sqe = rtio_sqe_acquire(&twim_rtio_context);
	// rtio_sqe_prep_i2c_recover(sqe,
	// 			  &twim_rtio_io_dev,
	// 			  0,
	// 			  NULL);

	rtio_submit(&twim_rtio_context, 1);

	cqe = rtio_cqe_consume(&twim_rtio_context);
    zassert_ok(cqe->result, "[RTIO CONFIG] rtio_cqe_consume failed: %d\n", cqe->result);
	rtio_cqe_release(&twim_rtio_context, cqe);

	// cqe = rtio_cqe_consume(&twim_rtio_context);
    // zassert_ok(cqe->result, "[RTIO RECOVER] rtio_cqe_consume failed: %d\n", cqe->result);
	// rtio_cqe_release(&twim_rtio_context, cqe);
}

static void twim_rtio_write(void)
{
	struct rtio_sqe *wr_sqe;
	struct rtio_cqe *wr_cqe;
	int ret;

	wr_sqe = rtio_sqe_acquire(&twim_rtio_context);
	rtio_sqe_prep_write(wr_sqe,
			    &twim_rtio_io_dev,
			    0,
			    fixture.master_buffer,
			    sizeof(fixture.master_buffer),
			    NULL);

	// wr_sqe->flags |= RTIO_SQE_TRANSACTION;
	wr_sqe->iodev_flags = RTIO_IODEV_I2C_STOP | RTIO_IODEV_I2C_RESTART;

	ret = rtio_submit(&twim_rtio_context, 1);
    zassert_ok(ret, "[RTIO WRITE] rtio_submit failed: %d\n", ret);


	wr_cqe = rtio_cqe_consume_block(&twim_rtio_context);
    zassert_ok(ret, "[RTIO WRITE] rtio_cqe_consume_block failed: %d\n", wr_cqe->result);

	rtio_cqe_release(&twim_rtio_context, wr_cqe);
}

static void *test_setup(void)
{
	const nrfx_twis_config_t config = {
		.addr = {fixture.addr, 0},
		.skip_gpio_cfg = true,
		.skip_psel_cfg = true,
	};
	int ret;

	zassert_equal(0, nrfx_twis_init(&twis, &config, i2s_slave_handler),
		      "TWIS initialization failed");

	PINCTRL_DT_DEFINE(NODE_TWIS);
	ret = pinctrl_apply_state(PINCTRL_DT_DEV_CONFIG_GET(NODE_TWIS), PINCTRL_STATE_DEFAULT);
	zassert_ok(ret);

	IRQ_CONNECT(DT_IRQN(NODE_TWIS), DT_IRQ(NODE_TWIS, priority),
		    nrfx_twis_irq_handler, &twis, 0);

	nrfx_twis_enable(&twis);

    twim_rtio_configure();

	return NULL;
}


ZTEST(twim_rtio_twis_loopback, test_twim_rtio_twis_transmission)
{
    cleanup_buffers();
    prepare_test_data(fixture.master_buffer, MAX_TEST_DATA_SIZE);

    show_buffers();

    twim_rtio_write();

    show_buffers();
}


ZTEST_SUITE(twim_rtio_twis_loopback, NULL, test_setup, NULL, NULL, NULL);
```
