## tests/benchmarks/memory_protection/testcase.yaml
```yaml
common:
  tags:
    - ci_tests_benchmarks_memory

tests:
  benchmarks.memory_protection:
    platform_allow:
      - nrf54l15dk/nrf54l15/cpuapp
      - nrf54l15dk/nrf54l15/cpuflpr
    integration_platforms:
      - nrf54l15dk/nrf54l15/cpuapp
```

## tests/drivers/i2s/i2s_latency/testcase.yaml
```yaml
common:
  tags:
    - drivers
    - ci_tests_zephyr_drivers_i2s
  harness: ztest

tests:
  drivers.i2s.i2s_latency:
    platform_allow:
      - nrf54h20dk/nrf54h20/cpuapp
      - nrf54l15dk/nrf54l15/cpuapp
    integration_platforms:
      - nrf54h20dk/nrf54h20/cpuapp
      - nrf54l15dk/nrf54l15/cpuapp
```
